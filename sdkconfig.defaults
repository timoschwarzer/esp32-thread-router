## sdkconfig.defaults
```kconfig
#
# Partition Table
#
CONFIG_PARTITION_TABLE_CUSTOM=y
CONFIG_PARTITION_TABLE_CUSTOM_FILENAME="partitions.csv"
CONFIG_PARTITION_TABLE_FILENAME="partitions.csv"
CONFIG_PARTITION_TABLE_OFFSET=0x8000
CONFIG_PARTITION_TABLE_MD5=y
# end of Partition Table

#
# mbedTLS
#
CONFIG_MBEDTLS_CMAC_C=y
CONFIG_MBEDTLS_SSL_PROTO_DTLS=y
CONFIG_MBEDTLS_KEY_EXCHANGE_ECJPAKE=y
CONFIG_MBEDTLS_ECJPAKE_C=y
# end of mbedTLS

#
# OpenThread
#
CONFIG_OPENTHREAD_PACKAGE_NAME="esp32-thread-router"
CONFIG_OPENTHREAD_PLATFORM_INFO="esp32h2"
CONFIG_OPENTHREAD_ENABLED=y
CONFIG_OPENTHREAD_BORDER_ROUTER=n
CONFIG_OPENTHREAD_DNS64_CLIENT=y
CONFIG_OPENTHREAD_AUTO_START=y
CONFIG_OPENTHREAD_STATE_INDICATOR_ENABLE=y
CONFIG_OPENTHREAD_STATE_INDICATOR_GPIO=8
# end of OpenThread

#
# Indicator of Leader Device
#
CONFIG_LEADER_INDICATOR_RED=25
CONFIG_LEADER_INDICATOR_GREEN=0
CONFIG_LEADER_INDICATOR_BLUE=15
# end of Indicator of Leader Device

#
# Indicator of Router Device
#
CONFIG_ROUTER_INDICATOR_RED=0
CONFIG_ROUTER_INDICATOR_GREEN=0
CONFIG_ROUTER_INDICATOR_BLUE=20
# end of Indicator of Router Device

#
# Indicator of Child Device
#
CONFIG_CHILD_INDICATOR_RED=40
CONFIG_CHILD_INDICATOR_GREEN=00
CONFIG_CHILD_INDICATOR_BLUE=0
# end of Indicator of Child Device


# NOTICE: On my board, the RED and GREEN channels are flipped for whatever reason...

#
# Indicator of Detached Device green
#
CONFIG_DETACHED_INDICATOR_RED=0
CONFIG_DETACHED_INDICATOR_GREEN=40
CONFIG_DETACHED_INDICATOR_BLUE=0
# end of Indicator of Detached Device

#
# lwIP
#
CONFIG_LWIP_TCPIP_TASK_STACK_SIZE=4096
CONFIG_LWIP_IPV6_NUM_ADDRESSES=8
CONFIG_LWIP_MULTICAST_PING=y
CONFIG_LWIP_HOOK_IP6_SELECT_SRC_ADDR_CUSTOM=y
# end of lwIP
```
